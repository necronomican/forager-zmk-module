## boards/shields/forager/Kconfig.defconfig
```kconfig
if SHIELD_FORAGER_DONGLE

config ZMK_KEYBOARD_NAME
    default "FORAGER"

config ZMK_SPLIT_ROLE_CENTRAL
    default y
endif

if SHIELD_FORAGER_LEFT || SHIELD_FORAGER_RIGHT || SHIELD_FORAGER_DONGLE

config ZMK_SPLIT
    default y

config ZMK_BLE
    default y

config ZMK_BATTERY_REPORTING
	default y
endif
```

## config/west.yml
```yaml
manifest:
  remotes:
    - name: zmkfirmware
      url-base: https://github.com/zmkfirmware
    - name: caksoylar
      url-base: https://github.com/caksoylar
    - name: b4skyx
      url-base: https://github.com/b4skyx
  projects:
    - name: zmk
      remote: zmkfirmware
      revision: main
      import: app/west.yml
    - name: zmk-rgbled-widget
      remote: caksoylar
      revision: main
    - name: prospector-zmk-module
      remote: b4skyx
      revision: main
  self:
    path: config
```
